## boards/tang_mega_138k/system16/linux/buildroot/Config.in
```kconfig
menu "System16 packages"
source "$BR2_EXTERNAL_SYSTEM16_PATH/package/native-gcc/Config.in"
source "$BR2_EXTERNAL_SYSTEM16_PATH/package/s16bench/Config.in"
endmenu
```

## boards/tang_mega_138k/system16/linux/buildroot/configs/system16_sd_defconfig
```kconfig
BR2_riscv=y
BR2_RISCV_32=y
BR2_riscv_custom=y
BR2_RISCV_ISA_RVM=y
BR2_RISCV_ISA_RVA=y
BR2_TOOLCHAIN_BUILDROOT_UCLIBC=y
BR2_TOOLCHAIN_BUILDROOT_WCHAR=y
BR2_TOOLCHAIN_BUILDROOT_CXX=y
BR2_ROOTFS_DEVICE_CREATION_DYNAMIC_DEVTMPFS=y
BR2_PACKAGE_BUSYBOX_SHOW_OTHERS=y
BR2_PACKAGE_BINUTILS=y
BR2_PACKAGE_BINUTILS_TARGET=y
BR2_PACKAGE_NATIVE_GCC=y
BR2_PACKAGE_MAKE=y
BR2_ROOTFS_POST_BUILD_SCRIPT="$(BR2_EXTERNAL_SYSTEM16_PATH)/board/system16/copy-dev-files.sh"
BR2_TARGET_ROOTFS_EXT2=y
BR2_TARGET_ROOTFS_EXT2_2r1=y
BR2_TARGET_ROOTFS_EXT2_SIZE="512M"
# BR2_TARGET_ROOTFS_TAR is not set
```

## boards/tang_mega_138k/system16/linux/buildroot/package/native-gcc/Config.in
```kconfig
config BR2_PACKAGE_NATIVE_GCC
	bool "native GCC C compiler"
	depends on BR2_TOOLCHAIN_BUILDROOT
	depends on BR2_USE_WCHAR
	select BR2_PACKAGE_BINUTILS
	select BR2_PACKAGE_BINUTILS_TARGET
	select BR2_PACKAGE_GMP
	select BR2_PACKAGE_MPFR
	select BR2_PACKAGE_MPC
	select BR2_PACKAGE_ZLIB
	help
	  Install a native C compiler built for the target itself.
```

## boards/tang_mega_138k/system16/linux/buildroot/package/s16bench/Config.in
```kconfig
config BR2_PACKAGE_S16BENCH
	bool "System16 memory benchmark"
	help
	  Install s16bench, a small sequential memory-bandwidth benchmark used
	  to compare the System16 SDRAM0 and DDR3 main-memory backends.
```

## boards/tang_mega_138k/system16/linux/kernel/Kconfig.gorv32
```kconfig
config GORV32_SD
	bool "Gowin GoRV32 Plus APB SD block device"
	depends on BLOCK && OF && RISCV
	help
	  Polling block driver for the SD host integrated in Gowin's GoRV32
	  Plus IP. The device-tree root window hides the raw boot sectors.
```

## boards/tang_mega_138k/system16/linux/kernel/Kconfig.ps2
```kconfig
config GORV32_PS2
	bool "System16 FPGA PS/2 keyboard"
	depends on INPUT && INPUT_KEYBOARD && OF && RISCV
	help
	  Polling input driver for the PS/2 Set-2 receiver synthesized into the
	  System16 FPGA at 0xe8800100.
```

## boards/tang_mega_138k/system16/linux/kernel/Kconfig.s16text
```kconfig
config SYS16_TEXTCON
	bool "System16 GoRV32 hardware text console"
	depends on VT && OF
	default n
	help
	  Console driver for the System16 GoRV32 FPGA hardware text mode: an
	  80x25 character-cell grid rendered from an on-chip 8x16 font ROM,
	  reached through the AXI slave window (cells at 0xE8000000, registers
	  at 0xE8800000). Cells are 16 bit (code + VGA-style attribute), so
	  output and scrolling move a couple of bytes per character instead of
	  a graphical framebuffer's pixels. Pairs with the USB-HID keyboard
	  for a full text console without a framebuffer.
```

## boards/tang_mega_138k/system16/linux/kernel/Kconfig.usbhid
```kconfig
config GORV32_USB_HID
	bool "System16 FPGA low-speed USB HID keyboard"
	depends on INPUT && INPUT_KEYBOARD && OF && RISCV
	help
	  Polling input driver for the compact USB HID host synthesized into the
	  System16 FPGA. The controller supports directly connected low-speed HID
	  keyboards; it is not a generic Linux USB host controller.
```
